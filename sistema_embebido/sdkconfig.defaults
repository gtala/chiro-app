## sistema_embebido/sdkconfig.defaults
```kconfig
# WiFi — editá SSID y password antes de flashear
CONFIG_EXAMPLE_CONNECT_WIFI=y
CONFIG_EXAMPLE_WIFI_SSID="GuilleWIFI24"
CONFIG_EXAMPLE_WIFI_PASSWORD="italia1832"
CONFIG_EXAMPLE_WIFI_AUTH_WPA2_PSK=y
```
